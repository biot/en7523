## Documentation/devicetree/bindings/gpio/airoha,en7523-gpio.yaml
```yaml
# SPDX-License-Identifier: GPL-2.0-only OR BSD-2-Clause
%YAML 1.2
---
$id: http://devicetree.org/schemas/gpio/airoha,en7523-gpio.yaml#
$schema: http://devicetree.org/meta-schemas/core.yaml#

title: Airoha EN7523 GPIO controller

maintainers:
  - John Crispin <john@phrozen.org>

description: |
    blah

properties:
  $nodename:
    pattern: "^gpio@[0-9a-f]+$"

  compatible:
    items:
      - const: airoha,en7523-gpio

  reg:
    items:

  "#gpio-cells":
    const: 2

  gpio-controller: true

required:
  - compatible
  - reg
  - gpio-controller
  - "#gpio-cells"

additionalProperties: false

examples:
  - |
      gpio@204 {
        compatible = "airoha,en7523-gpio";
        reg = <0x204 0x4>;
        gpio-controller;
        #gpio-cells = <2>;
      };

...
```

## Documentation/devicetree/bindings/spi/airoha-en7523-spi.yaml
```yaml
# SPDX-License-Identifier: (GPL-2.0-only OR BSD-2-Clause)
%YAML 1.2
---
$id: http://devicetree.org/schemas/spi/airoha-en7523-spi.yaml#
$schema: http://devicetree.org/meta-schemas/core.yaml#

title: Airoha EN7523 SPI controller

maintainers:
  - Bert Vermeulen <bert@biot.com>

allOf:
  - $ref: "spi-controller.yaml#"

properties:
  compatible:
    oneOf:
      - const: airoha,en7523-spi

  reg:
    maxItems: 1

required:
  - compatible
  - reg

unevaluatedProperties: false

examples:
  - |
    spi: spi@0 {
        compatible = "airoha,en7523-spi";
        reg = <0x0 0x140>;
        #address-cells = <1>;
        #size-cells = <0>;
    };
```

## image.its
```
/*
 * Simple U-boot uImage source file containing a single kernel and FDT blob
 */

/dts-v1/;

/ {
        description = "Kernel image with single Linux kernel, rootfs and FDT blob";
        #address-cells = <1>;

        images {
                fdt {
                        description = "Flattened Device Tree blob";
                        type = "flat_dt";
                        data = /incbin/("arch/arm/boot/dts/en7523-evb.dtb");
                        arch = "arm";
                        compression = "none";
                };
                kernel {
                        description = "Linux kernel";
                        type = "kernel";
                        data = /incbin/("Image.gzip");
                        arch = "arm";
                        os = "linux";
                        compression = "gzip";
                        load = <0x80088000>;
                        entry = <0x80088000>;
                        hash {
                                algo = "sha1";
                        };
                };
        };

        configurations {
                default = "kernel_only";
                kernel_only {
                        description = "Boot Linux kernel with FDT blob";
                        fdt = "fdt";
                        kernel = "kernel";
                };
                kernel_root {
                        description = "Boot Linux kernel with FDT blob";
                        fdt = "fdt";
                        kernel = "kernel";
                };
        };
};
```
